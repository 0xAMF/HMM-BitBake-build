## build/conf/local.conf
```bitbake
CC="/usr/bin/gcc"
AR="/usr/bin/ar"
CFLAGS="-g -Wall -fPIC"
PROJDIR="/home/fyd/stm/bitbake/hmmmmm/build/hmm/"
```

## meta-hmm/conf/layer.conf
```bitbake
BBPATH .= ":${LAYERDIR}"
BBFILES += "${LAYERDIR}/recipes-*/*/*.bb"
BBFILE_COLLECTIONS += "hmm"
BBFILE_PATTERN_hmm = "^${LAYERDIR}/"
BBFILE_PRIORITY_hmm = "5"
```
